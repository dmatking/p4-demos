## main/Kconfig
```kconfig
menu "P4 Demos"

choice BOARD
    prompt "Target board"
    default BOARD_P4_WAVESHARE

config BOARD_P4_WAVESHARE
    bool "Waveshare ESP32-P4-WIFI6-Touch-LCD-4B (720x720 ST7703)"

endchoice

endmenu
```

## sdkconfig.defaults
```kconfig
CONFIG_IDF_TARGET="esp32p4"
CONFIG_ESPTOOLPY_FLASHSIZE_16MB=y
CONFIG_ESP_DEFAULT_CPU_FREQ_360=y
CONFIG_ESP_CONSOLE_USB_SERIAL_JTAG=y
CONFIG_IDF_EXPERIMENTAL_FEATURES=y
CONFIG_SPIRAM=y
CONFIG_SPIRAM_MODE_HEX=y
CONFIG_SPIRAM_SPEED_200M=y
CONFIG_BOARD_P4_WAVESHARE=y
```
